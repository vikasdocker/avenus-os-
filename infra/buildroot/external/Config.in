## infra/buildroot/external/Config.in
```kconfig
source "$BR2_EXTERNAL_AETHER_PATH/package/aether-core/Config.in"
source "$BR2_EXTERNAL_AETHER_PATH/package/aether-system-core/Config.in"
```

## infra/buildroot/external/configs/aether_x86_64_qemu_defconfig
```kconfig
BR2_x86_64=y
BR2_TOOLCHAIN_BUILDROOT_MUSL=y
BR2_KERNEL_HEADERS_AS_KERNEL=y
BR2_PACKAGE_HOST_LINUX_HEADERS_CUSTOM_6_12=y
BR2_GCC_VERSION_13_X=y
BR2_TOOLCHAIN_BUILDROOT_CXX=y
BR2_TARGET_GENERIC_HOSTNAME="aether"
BR2_TARGET_GENERIC_ISSUE="Aether OS Phase 1.5"
BR2_INIT_NONE=y
BR2_ROOTFS_DEVICE_CREATION_DYNAMIC_DEVTMPFS=y
BR2_SYSTEM_DHCP=""
BR2_ENABLE_LOCALE_PURGE=y
BR2_PACKAGE_BUSYBOX=y
BR2_PACKAGE_AETHER_CORE=y
BR2_PACKAGE_AETHER_SYSTEM_CORE=y
BR2_ROOTFS_OVERLAY="$(BR2_EXTERNAL_AETHER_PATH)/overlays/rootfs"
BR2_ROOTFS_POST_BUILD_SCRIPT="$(BR2_EXTERNAL_AETHER_PATH)/board/aether/x86_64/post-build.sh"
BR2_LINUX_KERNEL=y
BR2_LINUX_KERNEL_CUSTOM_VERSION=y
BR2_LINUX_KERNEL_CUSTOM_VERSION_VALUE="6.12.103"
BR2_LINUX_KERNEL_USE_CUSTOM_CONFIG=y
BR2_LINUX_KERNEL_CUSTOM_CONFIG_FILE="$(BR2_EXTERNAL_AETHER_PATH)/board/aether/x86_64/linux.config"
BR2_LINUX_KERNEL_IMAGE=y
BR2_TARGET_ROOTFS_EXT2=y
BR2_TARGET_ROOTFS_EXT2_4=y
BR2_TARGET_ROOTFS_EXT2_SIZE="128M"
BR2_TARGET_ROOTFS_TAR=y
BR2_TARGET_ROOTFS_CPIO=y
BR2_TARGET_ROOTFS_CPIO_GZIP=y
```

## infra/buildroot/external/package/aether-core/Config.in
```kconfig
config BR2_PACKAGE_AETHER_CORE
	bool "aether-core"
	help
	  Install the minimal non-AI Aether Core service used by the
	  Phase 1.2 bootable Buildroot image. The service demonstrates
	  configuration loading, structured logging, health state,
	  graceful shutdown, and local IPC readiness without exposing
	  network services.
```

## infra/buildroot/external/package/aether-system-core/Config.in
```kconfig
config BR2_PACKAGE_AETHER_SYSTEM_CORE
	bool "aether-system-core"
	depends on BR2_PACKAGE_HOST_RUSTC_TARGET_ARCH_SUPPORTS
	select BR2_PACKAGE_AETHER_CORE
	select BR2_PACKAGE_HOST_RUSTC
	help
	  Install the Rust Aether System Core service manager and the
	  IPC-based aetherctl development CLI. This package also installs
	  the Phase 1.5 aether-filesystemd storage service used by System
	  Core after capability authorization. The System Core loads service
	  manifests, resolves dependencies, supervises process services,
	  evaluates health, exposes metrics, and serves the first local
	  Aether IPC control socket.
```
